## main/Kconfig.projbuild
```kconfig
# @file Kconfig.projbuild
# @brief Project configuration options
#
# Defines configurable parameters for hardware pins, motor settings,
# WiFi credentials, and operational limits.

menu "Automatic Soldering Station Configuration"

    menu "WiFi Configuration"
        config WIFI_SSID
            string "WiFi SSID"
            default "SolderingStation"
            help
                SSID for the WiFi Access Point

        config WIFI_PASSWORD
            string "WiFi Password"
            default "soldering123"
            help
                Password for WiFi AP (min 8 characters)

        config WIFI_CHANNEL
            int "WiFi Channel"
            default 1
            range 1 13
            help
                WiFi channel for AP

        config WIFI_MAX_CONNECTIONS
            int "Maximum WiFi Connections"
            default 4
            range 1 4
            help
                Maximum number of simultaneous client connections
    endmenu

    menu "Stepper Motor Pins - X Axis"
        config MOTOR_X_STEP_PIN
            int "X-Axis Step Pin"
            default 21
            help
                GPIO pin for X-axis stepper STEP signal (D21)

        config MOTOR_X_DIR_PIN
            int "X-Axis Direction Pin"
            default 12
            help
                GPIO pin for X-axis stepper DIR signal (D12)

        config MOTOR_X_ENABLE_PIN
            int "X-Axis Enable Pin"
            default 25
            help
                GPIO pin for X-axis stepper ENABLE signal (D25)
        config MOTOR_X_MIN_ENDPOINT_PIN
            int "X-Axis Minimum Endstop Pin"
            default 34
            help
                GPIO pin for X-axis minimum endstop switch (D12)
        config MOTOR_X_MM_IN_MICROSTEP_X1000
            int "Millimeters per Microstep (x1000)"
            default 40
            help
                Number of millimeters the X-axis moves per microstep (in x1000)
        config MOTOR_X_MICROSTEPS_IN_MM
            int "Microsteps per Millimeter"
            default 25
            help
                Number of microsteps required to move 1 millimeter
    endmenu

    menu "Stepper Motor Pins - Y Axis"
        config MOTOR_Y_STEP_PIN
            int "Y-Axis Step Pin"
            default 22
            help
                GPIO pin for Y-axis stepper STEP signal (D22)

        config MOTOR_Y_DIR_PIN
            int "Y-Axis Direction Pin"
            default 13
            help
                GPIO pin for Y-axis stepper DIR signal (D13)

        config MOTOR_Y_ENABLE_PIN
            int "Y-Axis Enable Pin"
            default 26
            help
                GPIO pin for Y-axis stepper ENABLE signal (D26)

        config MOTOR_Y_MIN_ENDPOINT_PIN
            int "Y-Axis Minimum Endstop Pin"
            default 35
            help
                GPIO pin for Y-axis minimum endstop switch (D13)
        config MOTOR_Y_MM_IN_MICROSTEP_X1000
            int "Millimeters per Microstep (x1000)"
            default 40
            help
                Number of millimeters the Y-axis moves per microstep (in x1000)
        config MOTOR_Y_MICROSTEPS_IN_MM
            int "Microsteps per Millimeter"
            default 25
            help
                Number of microsteps required to move 1 millimeter
    endmenu

    menu "Stepper Motor Pins - Z Axis"
        config MOTOR_Z_STEP_PIN
            int "Z-Axis Step Pin"
            default 23
            help
                GPIO pin for Z-axis stepper STEP signal (D23)

        config MOTOR_Z_DIR_PIN
            int "Z-Axis Direction Pin"
            default 4
            help
                GPIO pin for Z-axis stepper DIR signal (D4)

        config MOTOR_Z_ENABLE_PIN
            int "Z-Axis Enable Pin"
            default 32
            help
                GPIO pin for Z-axis stepper ENABLE signal (D32)
        config MOTOR_Z_MIN_ENDPOINT_PIN
            int "Z-Axis Minimum Endstop Pin"
            default 39
            help
                GPIO pin for Z-axis minimum endstop switch (D39)
        config MOTOR_Z_MM_IN_MICROSTEP_X1000
            int "Millimeters per Microstep (x1000)"
            default 10
            help
                Number of millimeters the Z-axis moves per microstep (in x1000)
                (10 = 0.01mm per microstep for 8mm/rev with 1/4 microstepping)
                
        config MOTOR_Z_MICROSTEPS_IN_MM
            int "Microsteps per Millimeter"
            default 100
            help
                Number of microsteps required to move 1 millimeter
                (100 = 800 microsteps per 8mm rotation with 1/4 microstepping)
    endmenu

    menu "Stepper Motor Pins - Solder Supply"
        config MOTOR_S_STEP_PIN
            int "Solder Supply Step Pin"
            default 14
            help
                GPIO pin for solder supply stepper STEP signal (D14 - Extruder)

        config MOTOR_S_DIR_PIN
            int "Solder Supply Direction Pin"
            default 16
            help
                GPIO pin for solder supply stepper DIR signal (D16 - Extruder)

        config MOTOR_S_ENABLE_PIN
            int "Solder Supply Enable Pin"
            default 33
            help
                GPIO pin for solder supply stepper ENABLE signal (D33 - Extruder)
        config MOTOR_S_MM_IN_MICROSTEP_X1000
            int "Millimeters per Microstep (x1000)"
            default 40
            help
                Number of millimeters the S-axis moves per microstep (in x1000)
        config MOTOR_S_MICROSTEPS_IN_MM
            int "Microsteps per Millimeter"
            default 25
            help
                Number of microsteps required to move 1 millimeter
    endmenu

    menu "Soldering Iron Configuration"
        config SOLDERING_IRON_PWM_PIN
            int "Soldering Iron PWM Pin"
            default 27
            help
                GPIO pin for soldering iron PWM control

        config SOLDERING_IRON_PWM_FREQUENCY
            int "PWM Frequency (Hz)"
            default 1000
            help
                PWM frequency for soldering iron control

        config SOLDERING_IRON_MAX_TEMP
            int "Maximum Temperature (°C)"
            default 450
            help
                Maximum allowed temperature for soldering iron

        config SOLDERING_IRON_DEFAULT_TEMP
            int "Default Temperature (°C)"
            default 350
            help
                Default temperature setting for soldering iron
    endmenu

    menu "Temperature Sensor Configuration (MAX6675 SPI)"
        config TEMP_SENSOR_SPI_HOST
            int "SPI Host ID"
            default 2 # (1=HSPI, 2=VSPI)
            help
                SPI Host to use (1 for HSPI, 2 for VSPI). VSPI_HOST=2.

        config TEMP_SENSOR_MISO_PIN
            int "SPI MISO Pin"
            default 19
            help
                GPIO pin for MAX6675 MISO (SO) signal

        config TEMP_SENSOR_CLK_PIN
            int "SPI CLK Pin"
            default 18
            help
                GPIO pin for MAX6675 CLK (SCK) signal

        config TEMP_SENSOR_CS_PIN
            int "SPI CS Pin"
            default 5
            help
                GPIO pin for MAX6675 CS signal
    endmenu

    menu "Web Server Configuration"
        config WEB_SERVER_PORT
            int "HTTP Server Port"
            default 80
            help
                Port for HTTP web server

        config WEB_SERVER_MAX_HANDLERS
            int "Maximum URI Handlers"
            default 20
            help
                Maximum number of URI handlers for web server
    endmenu

    menu "Task Watchdog Configuration"
        config ESP_TASK_WDT_TIMEOUT_S
            int "Task Watchdog Timeout (seconds)"
            default 30
            range 5 60
            help
                Watchdog timeout in seconds for motor control tasks.
                Set to 30 seconds to allow long motor movements without interruption.

        config ESP_TASK_WDT_CHECK_IDLE_TASK_CPU0
            bool "Watch CPU0 Idle Task"
            default y
            help
                Watch IDLE task on CPU0
                
        config ESP_TASK_WDT_CHECK_IDLE_TASK_CPU1
            bool "Watch CPU1 Idle Task"  
            default y
            help
                Watch IDLE task on CPU1
    endmenu



endmenu
```
